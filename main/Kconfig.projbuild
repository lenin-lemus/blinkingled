## main/Kconfig.projbuild
```kconfig
menu "Example Configuration"

    config ESP_WIFI_SSID
        string "FibraValencia_479A2"
        default "FibraValencia_479A2"
        help
            SSID (network name) for the example to connect to.

    config ESP_WIFI_PASSWORD
        string "Ktk2ByE9"
        default "Ktk2ByE9"
        help
            WiFi password (WPA or WPA2) for the example to use.

    config ESP_MAXIMUM_RETRY
        int "Maximum retry"
        default 5
        help
            Set the Maximum retry to avoid station reconnecting to the AP unlimited when the AP is really inexistent.
endmenu
```
